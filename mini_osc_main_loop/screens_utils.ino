// 0.1 Show App info at start up
void setup_oled_menu(){
  int16_t x,y;
  uint16_t w,h;
  uint8_t horizontal_cursor;

  I2C_OLED_2.begin(OLED_SDA_2, OLED_SCL_2); // 100000

  if(!OLED_Display_2.begin(0x3C, true)){
    Serial.println(F("OLED1 SH1106 allocation failed"));
    for(;;);
  }

  OLED_Display_2.clearDisplay();
  OLED_Display_2.setTextSize(1);
  OLED_Display_2.cp437(true);                 
  OLED_Display_2.setTextColor(SH110X_WHITE);

  OLED_Display_2.getTextBounds("Mini-Oscilloscope",0,0,&x,&y,&w,&h);
  horizontal_cursor = (SCREEN_WIDTH - w)/2;
  OLED_Display_2.setCursor(horizontal_cursor, 20);
  OLED_Display_2.println(F("Mini-Oscilloscope"));  

  OLED_Display_2.getTextBounds("v1.0",0,0,&x,&y,&w,&h);
  horizontal_cursor = (SCREEN_WIDTH - w)/2;
  OLED_Display_2.setCursor(horizontal_cursor, 35);
  OLED_Display_2.println(F("v1.0")); 

  OLED_Display_2.getTextBounds("github@stemilau",0,0,&x,&y,&w,&h);
  horizontal_cursor = (SCREEN_WIDTH - w)/2;
  OLED_Display_2.setCursor(horizontal_cursor, 50);            
  OLED_Display_2.println(F("github@stemilau"));                
  OLED_Display_2.display();
}

// 0.2 Show Wave logo at start up
void setup_oled_wave(){
  I2C_OLED_1.begin(OLED_SDA_1, OLED_SCL_1);

  if(!OLED_Display_1.begin(0x3C, true)){
    Serial.println(F("OLED2 SH1106 allocation failed"));
    for(;;);
  }
  // Show logo
  wave_image();
}

// 0.2.1 Logo shown at start up
void wave_image(){
  const unsigned char wave_bitmap [] PROGMEM = {
    0x00, 0x00, 0x00, 0x00, 0x00, 0x00, 0x00, 0x00, 0x00, 0x00, 0x00, 0x00, 0x00, 0x00, 0x00, 0x00, 
    0x00, 0x00, 0x00, 0x00, 0x00, 0x00, 0x00, 0x00, 0x00, 0x00, 0x00, 0x00, 0x00, 0x00, 0x00, 0x00, 
    0x00, 0x00, 0x00, 0x00, 0x00, 0x00, 0x00, 0x3f, 0xf0, 0x00, 0x00, 0x00, 0x00, 0x00, 0x00, 0x00, 
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    0x00, 0x00, 0x00, 0x00, 0x00, 0x00, 0x00, 0x00, 0x00, 0x00, 0x00, 0x00, 0x00, 0x00, 0x00, 0x00
  };

  OLED_Display_1.clearDisplay();
  OLED_Display_1.drawBitmap(0,0,wave_bitmap,SCREEN_WIDTH,SCREEN_HEIGHT,1);
  OLED_Display_1.display();
}

// 1. Writing default Wave grid
void write_wave_grid(){
  // OLED_Display_1.clearDisplay();                    // erase all(0.4ms)
  OLED_Display_1.setTextColor(SH110X_WHITE);        // write in white character

  OLED_Display_1.setCursor(85, 0);                  // Start at top-left corner
  OLED_Display_1.println(F("av    v"));             // 1-st line fixed characters
  OLED_Display_1.drawFastVLine(26, 9, 55, SH110X_WHITE);   // left vertical line
  OLED_Display_1.drawFastVLine(127, 9, 3, SH110X_WHITE);   // right vertical line up
  OLED_Display_1.drawFastVLine(127, 61, 3, SH110X_WHITE);  // right vertical line bottom

  OLED_Display_1.drawFastHLine(24, 9, 7, SH110X_WHITE);    // Max value auxiliary mark
  OLED_Display_1.drawFastHLine(24, 36, 2, SH110X_WHITE);
  OLED_Display_1.drawFastHLine(24, 63, 7, SH110X_WHITE);

  OLED_Display_1.drawFastHLine(51, 9, 3, SH110X_WHITE);    // Max value auxiliary mark
  OLED_Display_1.drawFastHLine(51, 63, 3, SH110X_WHITE);

  OLED_Display_1.drawFastHLine(76, 9, 3, SH110X_WHITE);    // Max value auxiliary mark
  OLED_Display_1.drawFastHLine(76, 63, 3, SH110X_WHITE);

  OLED_Display_1.drawFastHLine(101, 9, 3, SH110X_WHITE);   // Max value auxiliary mark
  OLED_Display_1.drawFastHLine(101, 63, 3, SH110X_WHITE);

  OLED_Display_1.drawFastHLine(123, 9, 5, SH110X_WHITE);   // right side Max value auxiliary mark
  OLED_Display_1.drawFastHLine(123, 63, 5, SH110X_WHITE);

  for (int x = 26; x <= 128; x += 5) {
    OLED_Display_1.drawFastHLine(x, 36, 2, SH110X_WHITE);  // Draw the center line (horizontal line) with a dotted line
  }
  for (int x = (127 - 25); x > 30; x -= 25) {
    for (int y = 10; y < 63; y += 5) {
      OLED_Display_1.drawFastVLine(x, y, 2, SH110X_WHITE); // Draw 3 vertical lines with dotted lines
    }
  }

  OLED_Display_1.display(); // refresh display ram
}

void write_wave_data(){
  write_wave_grid();
  // String offset_line = String((2.0 * v_div) / 1000.0 - offset) + "V";
  // spr.drawString(offset_line,  shift + 40, 59);
}

// 2. Writing default Secondary Menu grid
void write_menu_grid(){
  OLED_Display_2.drawFastHLine(0,0,127,SH110X_WHITE);
  OLED_Display_2.drawFastHLine(0,1,127,SH110X_WHITE);

  OLED_Display_2.drawFastHLine(0,10,127,SH110X_WHITE);
  OLED_Display_2.drawFastHLine(0,20,127,SH110X_WHITE);
  OLED_Display_2.drawFastHLine(0,31,127,SH110X_WHITE);
  OLED_Display_2.drawFastHLine(0,41,127,SH110X_WHITE);
  OLED_Display_2.drawFastHLine(0,51,127,SH110X_WHITE);

  OLED_Display_2.drawFastHLine(0,62,127,SH110X_WHITE);
  OLED_Display_2.drawFastHLine(0,63,127,SH110X_WHITE);
  
  OLED_Display_2.drawFastVLine(70,0,127,SH110X_WHITE);

  OLED_Display_2.display();
}

void write_measurements(String freq, float duty, String av, float vmax, float vmin){
  OLED_Display_2.setCursor(72, 3);
  OLED_Display_2.println(F("Vpp"));
  OLED_Display_2.setCursor(92, 3);
  OLED_Display_2.println(String(vmax - vmin) + "V");

  OLED_Display_2.setCursor(72, 13);
  OLED_Display_2.println(F("F"));
  OLED_Display_2.setCursor(80, 13);
  OLED_Display_2.println(freq);

  OLED_Display_2.setCursor(72, 23);
  OLED_Display_2.println(F("Duty"));
  OLED_Display_2.setCursor(98, 23);
  OLED_Display_2.println(String(duty) + "%");

  OLED_Display_2.setCursor(72, 33);
  OLED_Display_2.println(F("V"));
  OLED_Display_2.setCursor(78, 33);
  OLED_Display_2.write(0x18);
  OLED_Display_2.setCursor(86, 33);
  OLED_Display_2.println(String(vmax) + "V");

  OLED_Display_2.setCursor(72, 43);
  OLED_Display_2.println(F("V"));
  OLED_Display_2.setCursor(78, 43);
  OLED_Display_2.write(0x19);
  OLED_Display_2.setCursor(86, 43);
  OLED_Display_2.println(String(vmin) + "V");

  OLED_Display_2.setCursor(72, 53);
  OLED_Display_2.println(F("Av"));
  OLED_Display_2.setCursor(86, 53);
  OLED_Display_2.println(av);
  
  OLED_Display_2.display();
}

void highlight_option(uint8_t option){
  uint16_t top_left_x = 0;
  uint16_t top_left_y = 10 * option + 1;
  uint16_t height = 11;
  uint16_t width = 71;

  OLED_Display_2.fillRect(top_left_x, top_left_y, width, height, SH110X_INVERSE);
  OLED_Display_2.display();

  // blink selection if set_value is true
  // if(set_value){
  //   vTaskDelay(pdMS_TO_TICKS(500)); // 500 ms
  //   OLED_Display_2.fillRect(top_left_x, top_left_y, width, height, SH110X_INVERSE);
  //   OLED_Display_2.display();
  // }
}

void reset_previous_menu(){
  if(menu_page != previous_menu_page){
    OLED_Display_2.fillRect(0, 2, 70, 60, SH110X_BLACK); // reset menu area
    OLED_Display_2.fillRect(122, 53, 5, 8, SH110X_BLACK); // reset arrow right bottom corner
    previous_menu_page = menu_page; // reset previous page
  }
}

void write_menu_1_screen(float v_div, float s_div, float offset, float toffset, String wave_option){
  static const unsigned char PROGMEM image_arrow_curved_down_right_bits[] = {0x20,0x40,0x40,0xc0,0xe8,0x78,0x38,0x78};
  static const unsigned char PROGMEM image_autoset_button_bits[] = {0x38,0x44,0x82,0x92,0x82,0x44,0x38};

  OLED_Display_2.setTextColor(SH110X_BLACK);    
  OLED_Display_2.setTextColor(SH110X_WHITE);        
  OLED_Display_2.setCursor(2, 3);
  OLED_Display_2.println(F("Autoset"));
  OLED_Display_2.drawBitmap(46, 3, image_autoset_button_bits, 7, 7, 1);
  
  OLED_Display_2.setCursor(2, 13);
  OLED_Display_2.println(F("Cx"));
  OLED_Display_2.setCursor(16, 13);
  OLED_Display_2.println(String(int(v_div)) + "mV/div");

  OLED_Display_2.setCursor(2, 23);
  OLED_Display_2.println(F("Cy"));
  OLED_Display_2.setCursor(16, 23);
  OLED_Display_2.println(String(int(s_div)) + "us/div");

  OLED_Display_2.setCursor(2, 33);
  OLED_Display_2.println(F("V-off"));
  OLED_Display_2.setCursor(34, 33);
  OLED_Display_2.println(String(offset) + "V");

  OLED_Display_2.setCursor(2, 43);
  OLED_Display_2.println(F("T-off"));
  OLED_Display_2.setCursor(34, 43);
  OLED_Display_2.println(String((uint32_t)toffset) + "us");

  OLED_Display_2.setCursor(2, 53);
  OLED_Display_2.println(wave_option);
  
  OLED_Display_2.drawBitmap(122, 53, image_arrow_curved_down_right_bits, 5, 8, 1);

  //highlight_option(opt);

  OLED_Display_2.display();
}

void write_menu_2_screen(String str_filter, String str_stop, bool single_trigger){
  static const unsigned char PROGMEM image_arrow_curved_up_right_bits[] = {0x78,0x38,0x78,0xe8,0xc0,0x40,0x40,0x20};
  static const unsigned char PROGMEM image_help_icon_bits[] = {0x78,0xcc,0xcc,0x0c,0x18,0x30,0x00,0x30};

  OLED_Display_2.setTextColor(SH110X_WHITE);        
  OLED_Display_2.setCursor(2, 3);
  OLED_Display_2.println(F("Filter"));
  OLED_Display_2.setCursor(40, 3);
  OLED_Display_2.println(str_filter);
  
  OLED_Display_2.setCursor(2, 13);
  OLED_Display_2.println(F("SINGLE"));
  OLED_Display_2.setCursor(40, 13);
  OLED_Display_2.println(String(single_trigger ? "ON" : "OFF"));

  OLED_Display_2.setCursor(2, 23);
  OLED_Display_2.println(F("ACQ"));
  OLED_Display_2.setCursor(22, 23);
  OLED_Display_2.println(str_stop);

  OLED_Display_2.setCursor(2, 33);
  OLED_Display_2.println(F("Scale"));
  OLED_Display_2.setCursor(34, 33);
  OLED_Display_2.println("10x");

  OLED_Display_2.setCursor(1, 43);
  OLED_Display_2.println(F("Input"));
  OLED_Display_2.setCursor(34, 43);
  OLED_Display_2.println("AC");

  OLED_Display_2.setCursor(2, 53);
  OLED_Display_2.println(F("Help"));
  OLED_Display_2.drawBitmap(28, 53, image_help_icon_bits, 7, 8, 1);

  OLED_Display_2.drawBitmap(122, 53, image_arrow_curved_up_right_bits, 5, 8, 1);

  highlight_option(opt - 6);

  OLED_Display_2.display();
}